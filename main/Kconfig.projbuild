## main/Kconfig.projbuild
```kconfig
menu "MicroQuickJS"

config MQJS_MEM_SIZE
    int "MicroQuickJS heap size (bytes)"
    default 262144
    help
      Size of the static memory region reserved for the MicroQuickJS
      allocator. Reduce if you are not using external PSRAM, increase
      when you have PSRAM available.

endmenu
```

## sdkconfig.defaults
```kconfig
CONFIG_ESP_MAIN_TASK_STACK_SIZE=12288
CONFIG_ESP_TASK_WDT_EN=n
# Use native USB-CDC for console/REPL on the second USB-C “COM” port.
CONFIG_ESP_CONSOLE_USB_CDC=y
CONFIG_TINYUSB_CDC_ENABLED=y
CONFIG_TINYUSB_CDC_COUNT=2
# Disable other console transports.
CONFIG_ESP_CONSOLE_USB_SERIAL_JTAG=n
CONFIG_ESP_CONSOLE_UART_DEFAULT=n
CONFIG_PARTITION_TABLE_SINGLE_APP=y
CONFIG_PARTITION_TABLE_OFFSET=0x10000
CONFIG_MQJS_MEM_SIZE=262144
```

## sdkconfig.defaults.esp32c6
```kconfig
CONFIG_ESP_MAIN_TASK_STACK_SIZE=12288
CONFIG_ESP_TASK_WDT_EN=n
# ESP32-C6 has USB Serial/JTAG built-in (no separate USB OTG like S3)
CONFIG_ESP_CONSOLE_USB_SERIAL_JTAG=y
# Disable other console transports.
CONFIG_ESP_CONSOLE_USB_CDC=n
CONFIG_ESP_CONSOLE_UART_DEFAULT=n
CONFIG_PARTITION_TABLE_SINGLE_APP=y
CONFIG_PARTITION_TABLE_OFFSET=0x10000
CONFIG_MQJS_MEM_SIZE=262144
```

## sdkconfig.defaults.esp32h2
```kconfig
CONFIG_ESP_MAIN_TASK_STACK_SIZE=12288
CONFIG_ESP_TASK_WDT_EN=n
# ESP32-H2 has USB Serial/JTAG built-in (like C6)
CONFIG_ESP_CONSOLE_USB_SERIAL_JTAG=y
# Disable other console transports.
CONFIG_ESP_CONSOLE_USB_CDC=n
CONFIG_ESP_CONSOLE_UART_DEFAULT=n
CONFIG_PARTITION_TABLE_SINGLE_APP=y
CONFIG_PARTITION_TABLE_OFFSET=0x10000
# H2 has less RAM than S3/C6, use smaller heap
CONFIG_MQJS_MEM_SIZE=131072
```
